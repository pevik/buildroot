## package/ima-evm-utils/Config.in
```kconfig
config BR2_PACKAGE_IMA_EVM_UTILS
	bool "ima-evm-utils"
	depends on BR2_USE_MMU # keyutils dependency: fork()
	depends on !BR2_STATIC_LIBS # keyutils dependency: dlopen
	select BR2_PACKAGE_OPENSSL
	select BR2_PACKAGE_KEYUTILS
	help
	  Linux Integrity Measurement Architecture (IMA)
	  Extended Verification Module (EVM) tools.

	  https://sourceforge.net/p/linux-ima/wiki/Home/
```
